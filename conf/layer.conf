## conf/layer.conf
```bitbake
# We have a conf and classes directory, add to BBPATH
BBPATH .= ":${LAYERDIR}"

# We have a packages directory, add to BBFILES
BBFILES += "${LAYERDIR}/recipes-*/*/*.bb \
            ${LAYERDIR}/recipes-*/*/*.bbappend"

BBFILE_COLLECTIONS += "efi-layer"
BBFILE_PATTERN_efi-layer := "^${LAYERDIR}/"
BBFILE_PRIORITY_efi-layer = "7"

LAYERDEPENDS_efi-layer = "core"
LAYERSERIES_COMPAT_efi-layer = "kirkstone mickledore scarthgap"

# Let us add layer-specific bbappends which are only applied when that
# layer is included in our configuration
BBFILES += "${@' '.join('${LAYERDIR}/%s/recipes*/*/*.bbappend' % layer \
               for layer in BBFILE_COLLECTIONS.split())}"

SECURE_BOOT_PK_SIG ??= "${LAYERDIR}/recipes-efi/efi-keys/files/PK.sig"
SECURE_BOOT_PK_CERT ??= "${LAYERDIR}/recipes-efi/efi-keys/files/PK.crt"
SECURE_BOOT_PK_KEY ??= "${LAYERDIR}/recipes-efi/efi-keys/files/PK.key"
SECURE_BOOT_KEK_SIG ??= "${LAYERDIR}/recipes-efi/efi-keys/files/KEK.sig"
SECURE_BOOT_KEK_CERT ??= "${LAYERDIR}/recipes-efi/efi-keys/files/KEK.crt"
SECURE_BOOT_KEK_KEY ??= "${LAYERDIR}/recipes-efi/efi-keys/files/KEK.key"
SECURE_BOOT_DB_SIG ??= "${LAYERDIR}/recipes-efi/efi-keys/files/db.sig"
SECURE_BOOT_DB_CERT ??= "${LAYERDIR}/recipes-efi/efi-keys/files/db.crt"
SECURE_BOOT_DB_KEY ??= "${LAYERDIR}/recipes-efi/efi-keys/files/db.key"

SECURE_BOOT_SIGNING_KEY ??= "${SECURE_BOOT_DB_KEY}"
SECURE_BOOT_SIGNING_CERT ??= "${SECURE_BOOT_DB_CERT}"
```
